## stblinux-2.6.18/drivers/mtd/brcmnand/Kconfig
```kconfig
#
# linux/drivers/mtd/brcmnand/Kconfig
#

#menu "Broadcom NAND Flash Device Drivers"
#	depends on MTD != n

config MTD_BRCMNAND
	tristate "Broadcom NAND Device Support"
	default n
	depends on MTD
	select LONG_LONG_SUPPORT if MTD_BRCMNAND_VERSION >= 2
	select BRCM_SKIP_CHECK_BOOTROM
	help
	  This enables support for accessing selected types of NAND flash
	  devices through the Broadcom NAND controller.

config MTD_BRCMNAND_VERIFY_WRITE
	bool "Verify Broadcom NAND page writes"
	default n
	depends on MTD_BRCMNAND
	help
	  This adds an extra check when data is written to the flash. The
	  Broadcom NAND flash device internally checks only bits transitioning
	  from 1 to 0. There is a rare possibility that even though the
	  device thinks the write was successful, a bit could have been
	  flipped accidentaly due to device wear or something else.

# endmenu

config MTD_BRCMNAND_VERSION
	int "Broadcom Controller version number: 0 = v0.0, 1 = v0.1, 2 = v1.0"
	default 1
	depends on MTD_BRCMNAND
	help
		Version number of the controller.
		Value	Maj.Min Platform
			0		0.0			7400A0
		1	0.1	7401Cx, 7400B0, 7118A0, 7403 * 7451, 7452, 3563
		2	1.0	7440B0, 7405a0 (also 7118C0 running as 1.0 in 2.6.12)
		3	2.0	/* Not implemented for 2.6.12 */
		4	2.1	/* Not implemented for 2.6.12 */
		5	2.2	/* Not implemented for 2.6.12 */ 7118C0 & 7405b0 (in 2.6.18)
		6	3.0	/* Not implemented for 2.6.12 */ 3548a0 & 7443a0 (in 2.6.18)
		7	3.1	/* Not implemented for 2.6.12 */ 3548b0 & 7443a0 (in 2.6.18)

config MTD_BRCMNAND_CORRECTABLE_ERR_HANDLING
	bool "Refresh a block on a one bit correctable ECC error"
	default y
	depends on MTD_BRCMNAND
	help
	  If there is a 1-bit correctable error detected during NAND flash read, the
	  Broadcom NAND flash driver can refresh the corresponding NAND flash block.
	  Refreshing implies a sequence of read->erase->write. Refreshing the block
	  drastically reduces the probability of occurance of a similar (correctable)
	  error.
	  
config MTD_BRCMNAND_EDU
	bool "Enable Broadcom NAND EDU"
	default n
	depends on MTD_BRCMNAND && MIPS_BCM7440B0
	help
	   Enable DMA capability of the NAND controller.  
	   Currently only present on the following chips:
	   7440bx, 7440cx, 3548b0, 7443a0
```

## stblinux-2.6.18/drivers/net/brcmgenet/Kconfig
```kconfig
config BCMGENET_RX_DESC_THROTTLE 
	bool "use hardware rx descriptor throttling"
	depends on BCMUMAC
	default n
	help
	  Instead of generating one interrupt for rx packet, the unimac can 
	  generate 1 interrupt for multiple rx packet, thus to reduce the interrupt
	  number.

config BCMGENET_NAPI
	bool "use software rx descriptor throttling"
	depends on BCMUMAC
	default y
	help
	  Use software interrupt throttling(the NAPI approach).

config BCMGENET_RX_CSUM
	bool "Enable L4 checksum offloading for rx"
	depends on BCMUMAC
	default n
	help
	  Enable L4 checksum offloading for rx.

config BCMGENET_TX_CSUM
	bool "Enable L4 checksum offloading for tx"
	depends on BCMUMAC
	default n
	help
	  Enable L4 checksum offloading for tx.

config BCMGENET_DUMP_DATA
	bool "Dump out data for debugging"
	depends on BCMUMAC
	default n
	help
	  Dump out data for debugging.

config BCMGENET_DUMP_TRACE
	bool "Dump out trace message for debugging"
	depends on BCMUMAC
	default n
	help
	  Dump out trace messages for debugging.
```

## stblinux-2.6.18/drivers/net/brcmint7038/Kconfig
```kconfig
config BCMINTEMAC_NETLINK
	bool "Enable Netlink notification"
	depends on BCMINTEMAC_7038
	default y
	help
	    Enable link status notification.
```
